## config/west.yml
```yaml
manifest:
  remotes:
    - name: zmkfirmware
      url-base: https://github.com/zmkfirmware
    - name: hitsmaxft
      url-base: https://github.com/hitsmaxft
    - name: urob
      url-base: https://github.com/urob
    - name: janpfischer
      url-base: https://github.com/janpfischer
  projects:
    - name: zmk
      remote: zmkfirmware
      revision: v0.3.0
      clone-depth: 1
      import:
        file: app/west.yml
    - name: zmk-helpers
      remote: urob
      revision: main
      clone-depth: 1
    - name: zmk-rgbled-widget
      remote: hitsmaxft
      revision: 87c51b321ae48cec8759c8e137836e5052cc1288 # main
      #clone-depth: 1
    - name: zmk-dongle-display
      remote: hitsmaxft
      revision: 87c51b321ae48cec8759c8e137836e5052cc1288 # main
      #clone-depth: 1
    - name: zmk-dongle-screen
      remote: janpfischer
      revision: main
      clone-depth: 1
  self:
    path: config
```
